/*
 * MCUboot image overlay.
 *
 * The board defaults its console to USB-CDC (cdc_acm_serial.dtsi), but MCUboot
 * does not bring up the USB stack, so its console would reference a device that
 * is never instantiated (link error: undefined __device_dts_ord_*). Point the
 * bootloader console at the physical UART instead.
 */
/ {
	chosen {
		zephyr,console = &uart0;
		/* The board's nrf52840_partition.dtsi globally chooses slot0 as the
		 * code-partition, which (wrongly) links MCUboot into slot0 (0xc000).
		 * Pin the bootloader to boot_partition (0x0) so it owns the reset
		 * vector. The app image keeps slot0. */
		zephyr,code-partition = &boot_partition;
	};
};

&uart0 {
	status = "okay";
};
